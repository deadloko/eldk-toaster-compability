## meta-eldk/conf/distro/eldk.conf
```bitbake
DISTRO = "eldk"
DISTRO_NAME = "ELDK"
DISTRO_VERSION = "5.5"
SDK_VENDOR = "-eldk"
SDK_VERSION := "${DISTRO_VERSION}"

MAINTAINER = "Wolfgang Denk <wd@denx.de>"

TARGET_VENDOR = ""

LOCALCONF_VERSION = "1"

# Override these in ELDK based distros
ELDK_DEFAULT_DISTRO_FEATURES = "largefile opengl multiarch wayland"
ELDK_DEFAULT_EXTRA_RDEPENDS = "packagegroup-core-boot"
ELDK_DEFAULT_EXTRA_RRECOMMENDS = "kernel-module-af-packet"

DISTRO_FEATURES ?= "${DISTRO_FEATURES_DEFAULT} ${DISTRO_FEATURES_LIBC} ${ELDK_DEFAULT_DISTRO_FEATURES}"

# Strip the "generic-" from machine name
MACHINE_NO_GENERIC = "${@d.getVar('MACHINE', 1).replace('generic-', '')}"
MACHINE_STRIPPED = "${@d.getVar(['MACHINE', 'MACHINE_NO_GENERIC'][d.getVar('MACHINE', 1).startswith('generic-')], 1)}"

SDK_NAME = "${DISTRO}-${TCLIBC}-${SDK_ARCH}-${TARGET_ARCH}"
SDKPATH = "/opt/${DISTRO}-${DISTRO_VERSION}/${MACHINE_STRIPPED}"

DISTRO_EXTRA_RDEPENDS += " ${ELDK_DEFAULT_EXTRA_RDEPENDS}"
DISTRO_EXTRA_RRECOMMENDS += " ${ELDK_DEFAULT_EXTRA_RRECOMMENDS}"

TCLIBCAPPEND = ""

QEMU_TARGETS ?= "arm i386 mips mipsel ppc x86_64"
# Other QEMU_TARGETS "mips64 mips64el sh4"

MULTI_PROVIDER_WHITELIST += " virtual/kernel"

PREMIRRORS ?= "\
bzr://.*/.*   http://autobuilder.yoctoproject.org/sources/ \n \
cvs://.*/.*   http://autobuilder.yoctoproject.org/sources/ \n \
git://.*/.*   http://autobuilder.yoctoproject.org/sources/ \n \
hg://.*/.*    http://autobuilder.yoctoproject.org/sources/ \n \
osc://.*/.*   http://autobuilder.yoctoproject.org/sources/ \n \
p4://.*/.*    http://autobuilder.yoctoproject.org/sources/ \n \
svk://.*/.*   http://autobuilder.yoctoproject.org/sources/ \n \
svn://.*/.*   http://autobuilder.yoctoproject.org/sources/ \n"

MIRRORS =+ "\
ftp://.*/.*      http://autobuilder.yoctoproject.org/sources/ \n \
http://.*/.*     http://autobuilder.yoctoproject.org/sources/ \n \
https://.*/.*    http://autobuilder.yoctoproject.org/sources/ \n"

# The CONNECTIVITY_CHECK_URI's are used to test whether we can succesfully
# fetch from the network (and warn you if not). To disable the test set
# the variable to be empty.
# Git example url: git://git.yoctoproject.org/yocto-firewall-test;protocol=git;rev=HEAD

CONNECTIVITY_CHECK_URIS ?= " \
             https://eula-downloads.yoctoproject.org/index.php \
             http://bugzilla.yoctoproject.org/report.cgi"

SANITY_TESTED_DISTROS ?= " \
            Poky-1.3 \n \
            Poky-1.4 \n \
            Poky-1.5 \n \
            Ubuntu-12.04 \n \
            Ubuntu-12.10 \n \
            Ubuntu-13.04 \n \
            Fedora-17 \n \
            Fedora-18 \n \
            Fedora-19 \n \
            CentOS-6.3 \n \
            CentOS-6.4 \n \
            Debian-6.0 \n \
            Debian-7.0 \n \
            Debian-7.1 \n \
            SUSE-LINUX-12.2 \n \
            openSUSE-project-12.3 \n \
	    "

# Default hash policy for distro
BB_SIGNATURE_HANDLER ?= 'OEBasicHash'
#
# OELAYOUT_ABI allows us to notify users when the format of TMPDIR changes in 
# an incompatible way. Such changes should usually be detailed in the commit
# that breaks the format and have been previously discussed on the mailing list 
# with general agreement from the core team.
#
OELAYOUT_ABI = "8"

# add poky sanity bbclass
INHERIT += "poky-sanity"

# QA check settings - a little stricter than the OE-Core defaults
WARN_QA = "textrel files-invalid incompatible-license xorg-driver-abi libdir"
ERROR_QA = "dev-so debug-deps dev-deps debug-files arch pkgconfig la perms \
            useless-rpaths rpaths staticdev ldflags pkgvarcheck already-stripped \
            compile-host-path dep-cmp installed-vs-shipped install-host-path \
            packages-list perm-config perm-line perm-link pkgv-undefined \
            pn-overrides split-strip var-undefined version-going-backwards"

include conf/distro/include/seperatebuilddir.inc
```

## meta-eldk/conf/layer.conf
```bitbake
# We have a conf and classes directory, add to BBPATH
BBPATH := "${LAYERDIR}:${BBPATH}"

# We have a packages directory, add to BBFILES
BBFILES := "${BBFILES} ${LAYERDIR}/recipes-*/*/*.bb \
            ${LAYERDIR}/recipes-*/*/*.bbappend"

BBFILE_COLLECTIONS += "eldk"
BBFILE_PATTERN_eldk := "^${LAYERDIR}/"
BBFILE_PRIORITY_eldk = "5"
```

## meta-eldk/conf/machine/generic-armv5te.conf
```bitbake
#@TYPE: Machine
#@NAME: Generic armv5te machine
#@DESCRIPTION: Machine configuration for armv5te based boards

require conf/machine/include/tune-arm926ejs.inc

# variable needed for compilation
MACHINE_FEATURES ?= ""

PREFERRED_PROVIDER_virtual/kernel ?= "linux-eldk"
PREFERRED_PROVIDER_virtual/xserver ?= "xserver-xf86-lite"

KERNEL_IMAGETYPE = "uImage"
KERNEL_EXTRA_ARGS = "LOADADDR=0x80008000"

SERIAL_CONSOLE = "115200 console"
```

## meta-eldk/conf/machine/generic-armv6.conf
```bitbake
#@TYPE: Machine
#@NAME: Generic armv6 machine
#@DESCRIPTION: Machine configuration for armv6 based boards

DEFAULTTUNE = "armv6"

require conf/machine/include/tune-arm1136jf-s.inc

# variable needed for compilation
MACHINE_FEATURES ?= ""

PREFERRED_PROVIDER_virtual/kernel ?= "linux-eldk"
PREFERRED_PROVIDER_virtual/xserver ?= "xserver-xf86-lite"

KERNEL_IMAGETYPE = "uImage"
KERNEL_EXTRA_ARGS = "LOADADDR=0x80008000"

SERIAL_CONSOLE = "115200 console"
```

## meta-eldk/conf/machine/generic-armv7a-hf.conf
```bitbake
#@TYPE: Machine
#@NAME: Generic armv7a hard float machine
#@DESCRIPTION: Machine configuration for armv7a based boards

DEFAULTTUNE = "armv7ahf-neon"

require conf/machine/include/arm/arch-armv7a.inc

# variable needed for compilation
MACHINE_FEATURES ?= ""

PREFERRED_PROVIDER_virtual/kernel ?= "linux-eldk"
PREFERRED_PROVIDER_virtual/xserver ?= "xserver-xf86-lite"

KERNEL_IMAGETYPE = "uImage"
KERNEL_EXTRA_ARGS = "LOADADDR=0x80008000"

SERIAL_CONSOLE = "115200 console"
```

## meta-eldk/conf/machine/generic-mips.conf
```bitbake
#@TYPE: Machine
#@NAME: Generic MIPS machine
#@DESCRIPTION: Machine configuration for MIPS based boards

require conf/machine/include/qemu.inc
require conf/machine/include/tune-mips32.inc

# variable needed for compilation
MACHINE_FEATURES ?= ""

PREFERRED_PROVIDER_virtual/kernel = "linux-eldk"

KERNEL_IMAGETYPE = "vmlinux"
KERNEL_ALT_IMAGETYPE = "vmlinux.bin"

SERIAL_CONSOLE = "115200 console"

MACHINE_EXTRA_RRECOMMENDS = " kernel-modules"
```

## meta-eldk/conf/machine/generic-powerpc-4xx-softfloat.conf
```bitbake
#@TYPE: Machine
#@Name: powerpc-4xx-softfloat
#@DESCRIPTION: Machine configuration for APM PPC4xx (without FPU) based boards

# tune for 405 and 440 cores without FPU
DEFAULTTUNE = "ppc405"

require conf/machine/include/tune-ppc405.inc

# variable needed for compilation
MACHINE_FEATURES ?= ""

PREFERRED_PROVIDER_virtual/kernel = "linux-eldk"

KERNEL_IMAGETYPE = "uImage"

SERIAL_CONSOLE = "115200 ttyS0"
```

## meta-eldk/conf/machine/generic-powerpc-4xx.conf
```bitbake
#@TYPE: Machine
#@Name: powerpc-4xx
#@DESCRIPTION: Machine configuration for APM PPC4xx (with FPU) based boards

# tune for 440 core with FPU
DEFAULTTUNE = "ppc440e"

require conf/machine/include/tune-ppc440e.inc

# variable needed for compilation
MACHINE_FEATURES ?= ""

PREFERRED_PROVIDER_virtual/kernel = "linux-eldk"

KERNEL_IMAGETYPE = "uImage"

SERIAL_CONSOLE = "115200 ttyS0"
```

## meta-eldk/conf/machine/generic-powerpc-e500v2.conf
```bitbake
#@type: machine
#@name: powerpc-e500v2
#@description: Machine configuration for powerpc e500v2 based boards

DEFAULTTUNE = "ppce500v2"

require conf/machine/include/tune-ppce500v2.inc

MACHINEOVERRIDES .= ":e500v2"

# variable needed for compilation
MACHINE_FEATURES ?= ""

PREFERRED_PROVIDER_virtual/kernel ?= "linux-eldk"

KERNEL_IMAGETYPE = "uImage"

SERIAL_CONSOLE = "115200 ttyS0"
```

## meta-eldk/conf/machine/generic-powerpc.conf
```bitbake
#@TYPE: Machine
#@NAME: powerpc
#@DESCRIPTION: Generic PowerPC machine with FPU

require conf/machine/include/powerpc/arch-powerpc.inc

# variable needed for compilation
MACHINE_FEATURES ?= ""

PREFERRED_PROVIDER_virtual/kernel ?= "linux-eldk"
PREFERRED_PROVIDER_virtual/xserver ?= "xserver-xf86-lite"

KERNEL_IMAGETYPE = "uImage"

SERIAL_CONSOLE = "115200 console"
```

## meta-eldk/conf/machine/include/tune-ppc405.inc
```bitbake
DEFAULTTUNE ?= "ppc405"

require conf/machine/include/powerpc/arch-powerpc.inc

TUNEVALID[ppc405] = "Enable ppc405 specific processor optimizations"
TUNE_CCARGS += "${@bb.utils.contains("TUNE_FEATURES", "ppc405", "-mcpu=405", "", d)}"
TUNE_PKGARCH_tune-ppc405 = "ppc405"

AVAILTUNES += "ppc405"
TUNE_FEATURES_tune-ppc405 = "m32 ppc405 fpu-soft"
PACKAGE_EXTRA_ARCHS_tune-ppc405 = "ppc405"
```

## meta-eldk/conf/machine/include/tune-ppc440e.inc
```bitbake
DEFAULTTUNE ?= "ppc440e"

require conf/machine/include/powerpc/arch-powerpc.inc

TUNEVALID[ppc440e] = "Enable ppc440e specific processor optimizations"
TUNE_CCARGS += "${@bb.utils.contains("TUNE_FEATURES", "ppc440e", "-mcpu=440fp -mhard-float", "", d)}"
TUNE_PKGARCH_tune-ppc440e = "ppc440e"

AVAILTUNES += "ppc440e"
TUNE_FEATURES_tune-ppc440e = "m32 ppc440e"
PACKAGE_EXTRA_ARCHS_tune-ppc440e = "ppc440e"
```

## meta-eldk/conf/machine/m28evk.conf
```bitbake
#@TYPE: Machine
#@NAME: DENX M28 SoM Evaluation Kit
#@SOC: i.MX28
#@DESCRIPTION: Machine configuration for DENX M28 SoM Evaluation Kit

# Inherit config from generic-armv5te
require conf/machine/generic-armv5te.conf

IMAGE_CLASSES += " image_types_m28evk "

MACHINE_FEATURES ?= "apm usbhost alsa touchscreen"

SERIAL_CONSOLE = "115200 ttyAMA0"

# Kernel uImage LOADADDR
UBOOT_ENTRYPOINT := "0x40008000"
UBOOT_MAKE_TARGET := "u-boot.sb"
UBOOT_SUFFIX ?= "sb"
UBOOT_MACHINE = "m28evk_config"

PREFERRED_VERSION_u-boot ?= "v2014.01+gitAUTOINC+b44bd2c73c"
PREFERRED_VERSION_u-boot-mkimage ?= "v2014.01+gitAUTOINC+b44bd2c73c"

# Linux kernel 3.10 + patches
PREFERRED_PROVIDER_virtual/linux-ipipe = "linux-xenomai"
PREFERRED_VERSION_linux-eldk = "3.10.28+gitAUTOINC+020abbc911"
PREFERRED_VERSION_linux-xenomai = "3.10-ipipe"

# Ship kernel modules
MACHINE_EXTRA_RRECOMMENDS = "kernel-modules"
KERNEL_IMAGETYPE = "zImage"
KERNEL_DEVICETREE = "${S}/arch/arm/boot/dts/imx28-m28evk.dts"
# Add uImage LOADADDR
KERNEL_EXTRA_ARGS = "LOADADDR=${UBOOT_ENTRYPOINT}"

# Prepare the sdcard with boot partition (ext4) and rootfs (ext4)
SDCARD_BOOTFS ?= "${DEPLOY_DIR_IMAGE}/${IMAGE_NAME}.bootfs.ext4"
SDCARD_ROOTFS ?= "${DEPLOY_DIR_IMAGE}/${IMAGE_NAME}.rootfs.ext4"

# List of images to be built
IMAGE_FSTYPES ?= "tar.bz2 ext4 u-boot.sd u-boot.nand sdcard"
```

## meta-eldk/conf/machine/m53evk.conf
```bitbake
#@TYPE: Machine
#@NAME: DENX M53 SoM Evaluation Kit
#@SOC: i.MX53
#@DESCRIPTION: Machine configuration for DENX M53 SoM Evaluation Kit

# Inherit config from generic-armv7a-hf
require conf/machine/generic-armv7a-hf.conf

IMAGE_CLASSES += " image_types_m53evk"

MACHINE_FEATURES ?= "apm usbhost alsa touchscreen"

SERIAL_CONSOLE = "115200 ttymxc1"

# Kernel uImage LOADADDR
UBOOT_ENTRYPOINT := "0x70008000"
UBOOT_MAKE_TARGET := "u-boot.imx"
UBOOT_SUFFIX ?= "imx"
UBOOT_MACHINE = "m53evk_config"

PREFERRED_VERSION_u-boot ?= "v2014.01+gitAUTOINC+b44bd2c73c"
PREFERRED_VERSION_u-boot-mkimage ?= "v2014.01+gitAUTOINC+b44bd2c73c"

# Linux kernel 3.10 + patches
PREFERRED_PROVIDER_virtual/linux-ipipe = "linux-xenomai"
PREFERRED_VERSION_linux-eldk = "3.10.28+gitAUTOINC+020abbc911"
PREFERRED_VERSION_linux-xenomai = "3.10-ipipe"

# Ship kernel modules
MACHINE_EXTRA_RRECOMMENDS = "kernel-modules"
KERNEL_IMAGETYPE = "zImage"
KERNEL_DEVICETREE = "${S}/arch/arm/boot/dts/imx53-m53evk.dts"
# Add uImage LOADADDR and path to SDMA firmware
KERNEL_EXTRA_ARGS = "LOADADDR=${UBOOT_ENTRYPOINT}"

# Prepare the sdcard with boot partition (ext4) and rootfs (ext4)
SDCARD_BOOTFS ?= "${DEPLOY_DIR_IMAGE}/${IMAGE_NAME}.bootfs.ext4"
SDCARD_ROOTFS ?= "${DEPLOY_DIR_IMAGE}/${IMAGE_NAME}.rootfs.ext4"

# List of images to be built
IMAGE_FSTYPES ?= "tar.bz2 ext4 sdcard"
```

## meta-eldk/conf/machine/mpc5200.conf
```bitbake
#@TYPE: Machine
#@DESCRIPTION: Machine configuration for running

TARGET_FPU = ""

require conf/machine/include/tune-ppc603e.inc

KERNEL_IMAGETYPE = "uImage"

SERIAL_CONSOLE = "115200 ttyS0"

MACHINE_FEATURES = "keyboard pci ext2 ext3 serial"

PREFERRED_PROVIDER_virtual/kernel = "linux-eldk"

PREFERRED_PROVIDER_virtual/xserver = "xserver-kdrive"
XSERVER = "xserver-kdrive-fbdev"

UBOOT_ENTRYPOINT = "0x00000000"

# KERNEL_DEVICETREE = "${S}/arch/powerpc/boot/dts/mpc5200b.dtsi"

MACHINE_EXTRA_RRECOMMENDS = " kernel-modules"

# parameters for sysvinit inittab
SERIAL_CONSOLE = "115200 ttyPSC0"
```

## meta-eldk/conf/machine/mpc5200xenomai.conf
```bitbake
#@TYPE: Machine
#@DESCRIPTION: Machine configuration for running

TARGET_FPU = ""

require conf/machine/include/tune-ppc603e.inc

KERNEL_IMAGETYPE = "uImage"

SERIAL_CONSOLE = "115200 ttyS0"

MACHINE_FEATURES = "keyboard pci ext2 ext3 serial"

PREFERRED_PROVIDER_virtual/kernel = "linux-xenomai"
PREFERRED_VERSION_linux-xenomai = "3.5.7-ipipe"

PREFERRED_PROVIDER_virtual/xserver = "xserver-kdrive"
XSERVER = "xserver-kdrive-fbdev"

UBOOT_ENTRYPOINT = "0x00000000"

# KERNEL_DEVICETREE = "${S}/arch/powerpc/boot/dts/mpc5200b.dtsi"

MACHINE_EXTRA_RRECOMMENDS = " kernel-modules"

# parameters for sysvinit inittab
SERIAL_CONSOLE = "115200 ttyPSC0"
```
